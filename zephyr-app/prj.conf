## CMakeLists.txt
```
# CMakeLists.txt for Nordic NUS Zephyr App

# Set minimum CMake version
cmake_minimum_required(VERSION 3.13)

# Set project name and version
project(nus_app VERSION 0.1 LANGUAGES C)

# Include Zephyr as a module
find_package(Zephyr REQUIRED HINTS $ENV{ZEPHYR_BASE})
include(${ZEPHYR_BASE}/cmake/app/boilerplate.cmake)

# Source files in the application
set(SOURCES
    src/main.c
)

# Add executable target
zephyr_app_sources(${SOURCES})

# Optionally, add other required configurations such as libraries or dependencies
# target_link_libraries(my_target additional_library)
```

## prj.conf
```kconfig
# Nordic NUS Configuration for Zephyr App

# General settings
CONFIG_FLASH=y
CONFIG_LOG=y

# Bluetooth settings
CONFIG_BT=y
CONFIG_BT_NUS=y
CONFIG_BT_NUS_SERVICE_NAME="Nordic UART Service"

# Other application settings
CONFIG_MAIN_STACK_SIZE=2048
CONFIG_HEAP_MEM_POOL_SIZE=2048
```

## src/main.c
```c
#include <zephyr.h>\n#include <sys/printk.h>\n#include <bluetooth/bluetooth.h>\n#include <bluetooth/gatt.h>\n#include <bluetooth/services/nus.h>\n\nvoid main(void) {\n    int err;\n\n    err = bt_enable(NULL);\n    if (err) {\n        printk("Bluetooth initialize failed (err %d)\n", err);\n        return;\n    }\n\n    printk("Bluetooth initialized\n");\n\n    // Initialize the Nordic UART Service (NUS)\n    err = nus_init();\n    if (err) {\n        printk("NUS initialization failed (err %d)\n", err);\n        return;\n    }\n\n    printk("NUS initialized\n");\n}
```
